## buildroot-ihost/Config.in
```kconfig
source "$BR2_EXTERNAL_IHOST_PATH/package/matter/Config.in"
source "$BR2_EXTERNAL_IHOST_PATH/package/rtk_hciattach/Config.in"
```

## buildroot-ihost/package/debugger/Config.in
```kconfig
config BR2_PACKAGE_DEBUGGER
    bool "debugger support"
    depends on BR2_PACKAGE_NODEJS
    help
      debugger support
```

## buildroot-ihost/package/rtk_hciattach/Config.in
```kconfig
config BR2_PACKAGE_RTK_HCIATTACH
  bool "rtk_hciattach"
  help
    rtk_hciattach application
```
